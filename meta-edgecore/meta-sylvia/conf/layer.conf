## meta-edgecore/meta-sylvia/conf/layer.conf
```bitbake
# We have a conf and classes directory, add to BBPATH
BBPATH .= ":${LAYERDIR}"

# We have recipes-* directories, add to BBFILES
BBFILES += "${LAYERDIR}/recipes-*/*/*.bb \
            ${LAYERDIR}/recipes-*/*/*.bbappend"

BBFILE_COLLECTIONS += "sylvia-layer"
BBFILE_PATTERN_sylvia-layer = "^${LAYERDIR}/"
LAYERSERIES_COMPAT_sylvia-layer = "thud warrior"
```
